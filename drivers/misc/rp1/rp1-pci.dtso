// SPDX-License-Identifier: (GPL-2.0 OR MIT)

/* the dts overlay is included from the dts directory so
 * it can be possible to check it with CHECK_DTBS while
 * also compile it from the driver source directory.
 */

#include "arm64/broadcom/rp1.dtso"
