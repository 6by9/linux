## Documentation/devicetree/bindings/media/i2c/sony,imx678.yaml
```yaml
# SPDX-License-Identifier: (GPL-2.0-only OR BSD-2-Clause)
# Copyright (C) 2026 Ideas on Board Oy
%YAML 1.2
---
$id: http://devicetree.org/schemas/media/i2c/sony,imx678.yaml#
$schema: http://devicetree.org/meta-schemas/core.yaml#

title: Sony IMX678 and Starvis 2 Sensors

maintainers:
  - Jai Luthra <jai.luthra@ideasonboard.com>

description:
  Sony IMX678 diagonal 8.86 mm (Type 1/1.8) CMOS active pixel type solid-state
  image sensor with a square pixel array and 8.40M (3856x2180) effective pixels.
  It is part of the Starvis 2 family of sensors.
  Other members of the Starvis 2 have the same hardware requirements, and
  therefore share this binding.

allOf:
  - $ref: /schemas/media/video-interface-devices.yaml#

properties:
  compatible:
    oneOf:
      - items:
        - enum:
            - sony,imx678-aamr
            - sony,imx678-aaqr
        - const: sony,imx678
      - items:
        - enum:
            - sony,imx585-aamj
            - sony,imx585-aaqj
        - const: sony,imx585
      - items:
        - enum:
            - sony,imx675-aamr
            - sony,imx675-aaqr
        - const: sony,imx675
      - items:
        - enum:
            - sony,imx662-aamr
            - sony,imx662-aaqr
        - const: sony,imx662
      - items:
        - enum:
            - sony,imx832-amr
            - sony,imx832-aqr
        - const: sony,imx832

    description:
      The IMX678 sensor exists in a colour variant (IMX678-AAQR) and a mono
      variant (IMX678-AAMR). The variant-specific compatible describes the
      exact sensor variant, with the generic IMX678 compatible as a fallback.
      The same applies for the other sensors in the family.

  reg:
    maxItems: 1

  clocks:
    description: |
      Input clock (INCK). Only the rates listed in the datasheet are supported:
      13.5, 18, 24, 27, 36, 37.125, 72, and 74.25 MHz.
    maxItems: 1

  avdd-supply:
    description: Analog power supply (3.3V)

  ovdd-supply:
    description: Interface power supply (1.8V)

  dvdd-supply:
    description: Digital power supply (1.1V)

  reset-gpios:
    description: Sensor RESETN (XCLR) GPIO
    maxItems: 1

  port:
    $ref: /schemas/graph.yaml#/$defs/port-base
    additionalProperties: false

    properties:
      endpoint:
        $ref: /schemas/media/video-interfaces.yaml#
        unevaluatedProperties: false

        properties:
          data-lanes:
            oneOf:
              - items:
                  - const: 1
                  - const: 2
              - items:
                  - const: 1
                  - const: 2
                  - const: 3
                  - const: 4
              - items:
                  - const: 1
                  - const: 2
                  - const: 3
                  - const: 4
                  - const: 5
                  - const: 6
                  - const: 7
                  - const: 8

        required:
          - data-lanes
          - link-frequencies

    required:
      - endpoint

required:
  - compatible
  - reg
  - clocks
  - avdd-supply
  - ovdd-supply
  - dvdd-supply
  - port

unevaluatedProperties: false

examples:
  - |
    #include <dt-bindings/gpio/gpio.h>

    i2c {
        #address-cells = <1>;
        #size-cells = <0>;

        camera@1a {
            compatible = "sony,imx678-aaqr", "sony,imx678";
            reg = <0x1a>;
            clocks = <&imx678_clk>;

            avdd-supply = <&camera_avdd_3v3>;
            ovdd-supply = <&camera_ovdd_1v8>;
            dvdd-supply = <&camera_dvdd_1v1>;

            reset-gpios = <&gpio 0 GPIO_ACTIVE_LOW>;

            port {
                imx678: endpoint {
                    remote-endpoint = <&cam>;
                    data-lanes = <1 2 3 4>;
                    link-frequencies = /bits/ 64 <720000000>;
                };
            };
        };
    };
...
```

## drivers/input/touchscreen/ilitek-v3/Kconfig
```kconfig
# SPDX-License-Identifier: GPL-2.0-only
#
# Touchscreen driver configuration
#
config TOUCHSCREEN_ILITEK_V3
	tristate "Ilitek V3 based touchscreen"
	depends on I2C
	select CRC_CCITT
	help
	  Say Y here if you have a Ilitek V3 based touchscreen
	  controller, such as that found in ILI79600A

	  If unsure, say N.

	  To compile this driver as a module, choose M here: the
	  module will be called ilitek_v3_touch.
```
