## Documentation/devicetree/bindings/media/i2c/melexis,mlx7502x.yaml
```yaml
# SPDX-License-Identifier: (GPL-2.0 OR BSD-2-Clause)
%YAML 1.2
---
$id: http://devicetree.org/schemas/media/i2c/melexis,mlx7502x.yaml#
$schema: http://devicetree.org/meta-schemas/core.yaml#

title: Melexis ToF 7502x MIPI CSI-2 Sensor

maintainers:
  - Volodymyr Kharuk <vkh@melexis.com>

description: |-
  Melexis ToF 7502x sensors has a CSI-2 output. It supports 2 and 4 lanes,
  and mipi speeds are 300, 600, 704, 800, 904, 960Mbs. Supported format is RAW12.
  Sensor 75026 is QVGA, while 75027 is VGA sensor.

properties:
  compatible:
    enum:
      - melexis,mlx75026
      - melexis,mlx75027

  reg:
    maxItems: 1

  clocks:
    description: Clock frequency 8MHz
    maxItems: 1

  vdda-supply:
    description:
      Analog power supply(2.7V).

  vddif-supply:
    description:
      Interface power supply(1.8V).

  vddd-supply:
    description:
      Digital power supply(1.2V).

  vdmix-supply:
    description:
      Mixed driver power supply(1.2V).

  reset-gpios:
    maxItems: 1
    description: Reset Sensor GPIO Control (active low)

  port:
    description: MIPI CSI-2 transmitter port
    $ref: /schemas/graph.yaml#/$defs/port-base

    properties:
      endpoint:
        $ref: /schemas/media/video-interfaces.yaml#
        unevaluatedProperties: false

        properties:
          data-lanes:
            oneOf:
              - items:
                  - const: 1
                  - const: 2
              - items:
                  - const: 1
                  - const: 2
                  - const: 3
                  - const: 4

        required:
          - data-lanes
          - link-frequencies

required:
  - compatible
  - reg
  - clocks
  - port
  - vdda-supply
  - vddif-supply
  - vddd-supply
  - vdmix-supply

additionalProperties: false

examples:
  - |
    #include <dt-bindings/gpio/gpio.h>

    i2c {
        #address-cells = <1>;
        #size-cells = <0>;

        mlx7502x: camera@57 {
            compatible = "melexis,mlx75027";
            reg = <0x57>;
            clocks = <&mlx7502x_clk>;

            assigned-clocks = <&mlx7502x_clk>;
            assigned-clock-parents = <&mlx7502x_clk_parent>;
            assigned-clock-rates = <8000000>;

            vdda-supply = <&reg_2v7>;
            vddif-supply = <&reg_1v8>;
            vddd-supply = <&reg_1v2>;
            vdmix-supply = <&reg_1v2>;

            reset-gpios = <&gpio_exp 6 GPIO_ACTIVE_HIGH>;

            port {
                mlx7502x_out_mipi_csi2: endpoint {
                    remote-endpoint = <&mipi_csi2_from_mlx7502x>;
                    data-lanes = <1 2 3 4>;
                    link-frequencies = /bits/ 64 < 960000000
                                                   904000000
                                                   800000000
                                                   704000000
                                                   600000000
                                                   300000000 >;
                };
            };
        };
    };

...
```

## Documentation/devicetree/bindings/media/i2c/onnn,ar0144.yaml
```yaml
# SPDX-License-Identifier: (GPL-2.0-only OR BSD-2-Clause)
%YAML 1.2
---
$id: http://devicetree.org/schemas/media/i2c/onnn,ar0144.yaml#
$schema: http://devicetree.org/meta-schemas/core.yaml#

title: ON Semiconductor AR0144 MIPI CSI-2 sensor

maintainers:
  - Krzysztof Hałasa <khalasa@piap.pl>

description: |
  The AR0144 is a 1/4" 1MP raw CMOS image sensor with MIPI CSI-2 and parallel
  outputs, and an I2C-compatible control interface.

  The sensor comes in a regular CMOS version (AR0144CS) and an automotive
  version (AR0144AT). The former is further declined in a colour version
  (AR0144CSSC) and a monochrome version (AR0144CSSM), while the later exists
  only in monochrome (AR0144ATSM)

allOf:
  - $ref: /schemas/media/video-interface-devices.yaml#

properties:
  compatible:
    enum:
      - onnn,ar0144c  # Color version
      - onnn,ar0144m  # Monochrome version

  reg:
    maxItems: 1

  clocks:
    maxItems: 1

  vaa-supply:
    description:
      Supply for the VAA and VAA_PIX analog power rails (2.8V).

  vdd-supply:
    description:
      Supply for the VDD and VDD_PHY digital power rails (1.2V).

  vddio-supply:
    description:
      Supply for the VDD_IO digital I/O power rail (1.8V or 2.8V).

  reset-gpios:
    description: Reset GPIO, active low.
    maxItems: 1

  port:
    $ref: /schemas/graph.yaml#/$defs/port-base
    unevaluatedProperties: false
    description:
      Video output port.

    properties:
      endpoint:
        $ref: /schemas/media/video-interfaces.yaml#
        unevaluatedProperties: false

        properties:
          bus-type:
            enum:
              - 4 # MEDIA_BUS_TYPE_CSI2_DPHY
              - 5 # MEDIA_BUS_TYPE_PARALLEL

          data-lanes:
            items:
              - const: 1
              - const: 2

          bus-width:
            enum: [8, 10, 12]
            default: 12

          data-shift:
            enum: [0, 2, 4]
            default: 0

          pclk-sample:
            enum: [0, 1]
            default: 0

        allOf:
          - if:
              properties:
                bus-type:
                  const: 4 # MEDIA_BUS_TYPE_CSI2_DPHY
            then:
              properties:
                bus-width: false
                data-shift: false
                pclk-sample: false
              required:
                - data-lanes
            else:
              properties:
                data-lanes: false
          - if:
              properties:
                bus-width:
                  const: 10
            then:
              properties:
                data-shift:
                  enum: [0, 2]
          - if:
              properties:
                bus-width:
                  const: 12
            then:
              properties:
                data-shift:
                  const: 0

        required:
          - bus-type

required:
  - compatible
  - reg
  - clocks
  - clock-names
  - vaa-supply
  - vdd-supply
  - vddio-supply
  - port

unevaluatedProperties: false

examples:
  - |
    #include <dt-bindings/gpio/gpio.h>
    #include <dt-bindings/media/video-interfaces.h>

    i2c {
        #address-cells = <1>;
        #size-cells = <0>;

        camera@10 {
            compatible = "onnn,ar0144c";
            reg = <0x10>;

            clocks = <&cam_clk>;

            reset-gpios = <&gpio1 6 GPIO_ACTIVE_LOW>;

            vaa-supply = <&reg_2v8>;
            vdd-supply = <&reg_1v2>;
            vddio-supply = <&reg_1v8>;

            port {
                ar0144_out: endpoint {
                    remote-endpoint = <&mipi_csi2_in>;
                    bus-type = <MEDIA_BUS_TYPE_CSI2_DPHY>;
                    data-lanes = <1 2>;
                };
            };
        };
    };
```

## Documentation/devicetree/bindings/media/i2c/ovti,ov7251.yaml
```yaml
# SPDX-License-Identifier: (GPL-2.0 OR BSD-2-Clause)
%YAML 1.2
---
$id: http://devicetree.org/schemas/media/i2c/sony,imx290.yaml#
$schema: http://devicetree.org/meta-schemas/core.yaml#

title: Omnivision 1/7.5-Inch B&W VGA CMOS Digital Image Sensor

maintainers:

description: |-
The Omnivision OV7251 is a 1/7.5-Inch CMOS active pixel digital image sensor
with an active array size of 640H x 480V. It is programmable through a serial
I2C interface.

properties:
  compatible:
    enum:
      - ovti,ov7251

  reg:
    maxItems: 1

  clocks:
    maxItems: 1

  clock-names:
    description: Input clock (6-27 MHz)
    items:
      - const: xclk

  clock-frequency:
    description: Frequency of the xclk clock in Hz

  vdddo-supply:
    description: Chip digital IO regulator.

  vdda-supply:
    description: Chip analog regulator

  vddd-supply:
    description: Chip digital core regulator

  enable-gpios:
    description: Chip enable GPIO. Polarity is GPIO_ACTIVE_HIGH. This
                 corresponds to the hardware pin XSHUTDOWN which is physically
                 active low.
    maxItems: 1

  port:
    $ref: /schemas/graph.yaml#/$defs/port-base
    description: |
      Video output port

    properties:
      endpoint:
        $ref: /schemas/media/video-interfaces.yaml#
        unevaluatedProperties: false

        properties:
          data-lanes:
            anyOf:
              - items:
                  - const: 1

          link-frequencies: true

        required:
          - data-lanes
          - link-frequencies

    additionalProperties: false

required:
  - compatible
  - reg
  - clocks
  - clock-names
  - clock-frequency
  - enable-gpios
  - vdddo-supply
  - vdda-supply
  - vddd-supply
  - port

additionalProperties: false

examples:
  - |
    #include <dt-bindings/gpio/gpio.h>

    i2c {
        #address-cells = <1>;
        #size-cells = <0>;

        ov7251: camera-sensor@60 {
            compatible = "ovti,ov7251";
            reg = <0x60>;

            clocks = <&clk 90>;
            clock-names = "xclk";
            clock-frequency = <37125000>;

            vdddo-supply = <&camera_vdddo>;
            vdda-supply = <&camera_vdda>;
            vddd-supply = <&camera_vddd>;

            enable-gpios = <&gpio 35 GPIO_ACTIVE_LOW>;

            port {
                ov7251_ep: endpoint {
                    data-lanes = <1>;
                    link-frequencies = /bits/ 64 <240000000>;
                    remote-endpoint = <&csi_ep>;
                };
            };
        };
    };
...
```

## Documentation/devicetree/bindings/media/i2c/sony,imx290.yaml
```yaml
# SPDX-License-Identifier: (GPL-2.0-only OR BSD-2-Clause)
%YAML 1.2
---
$id: http://devicetree.org/schemas/media/i2c/sony,imx290.yaml#
$schema: http://devicetree.org/meta-schemas/core.yaml#

title: Sony IMX290 1/2.8-Inch CMOS Image Sensor Device Tree Bindings

description: |-
  The Sony IMX290 is a 1/2.8-Inch CMOS Solid-state image sensor with
  Square Pixel for Color Cameras. It is programmable through I2C and 4-wire
  interfaces. The sensor output is available via CMOS logic parallel SDR output,
  Low voltage LVDS DDR output and CSI-2 serial data output. The CSI-2 bus is the
  default. No bindings have been defined for the other busses.

maintainers:
  - Manivannan Sadhasivam <mani@kernel.org>

allOf:
  - $ref: /schemas/media/video-interface-devices.yaml#

properties:
  compatible:
    const: sony,imx290

  reg:
    maxItems: 1

  clocks:
    description: XCLK Input Clock

  clock-names:
    const: xclk

  clock-frequency:
    description:
      Frequency of the xvclk clock in Hertz.

  vdda-supply:
    description: Analog voltage supply

  vddd-supply:
    description: Digital core voltage supply

  vdddo-supply:
    description: Digital I/O voltage supply

  reset-gpios:
    maxItems: 1
    description: |-
      Reference to the GPIO to connected to the reset line, if any

  rotation:
    enum:
      - 0
      - 180

  port:
    description: Digital Output Port
    $ref: /schemas/graph.yaml#/$defs/port-base
    additionalProperties: false

    properties:
      endpoint:
        $ref: /schemas/media/video-interfaces.yaml#
        unevaluatedProperties: false

        properties:
          clock-lanes:
            const: 0

          data-lanes:
            oneOf:
              - items:
                  - const: 1
                  - const: 2
                  - const: 3
                  - const: 4
              - items:
                  - const: 1
                  - const: 2

          link-frequencies: true

        required:
          - data-lanes
          - link-frequencies

required:
  - compatible
  - reg
  - clocks
  - clock-names
  - clock-frequency
  - vdda-supply
  - vddd-supply
  - vdddo-supply
  - port

additionalProperties: false

examples:
  - |
    #include <dt-bindings/gpio/gpio.h>

    &i2c {
      imx290: camera-sensor@1a {
        compatible = "sony,imx290";
        reg = <0x1a>;

        reset-gpios = <&gpio 35 GPIO_ACTIVE_LOW>;
        pinctrl-names = "default";
        pinctrl-0 = <&camera_rear_default>;

        clocks = <&clock 0>;
        clock-names = "xclk";
        clock-frequency = <37125000>;

        vdddo-supply = <&camera_vdddo>;
        vdda-supply = <&camera_vdda>;
        vddd-supply = <&camera_vddd>;

        port {
          imx290_ep: endpoint {
            data-lanes = <1 2 3 4>;
            link-frequencies = /bits/ 64 <445500000>;
            remote-endpoint = <&csiphy0_ep>;
          };
        };
      };

...
```

## Documentation/devicetree/bindings/misc/pci1de4,1.yaml
```yaml
# SPDX-License-Identifier: (GPL-2.0-only OR BSD-2-Clause)
%YAML 1.2
---
$id: http://devicetree.org/schemas/misc/pci1de4,1.yaml#
$schema: http://devicetree.org/meta-schemas/core.yaml#

title: RaspberryPi RP1 MFD PCI device

maintainers:
  - Andrea della Porta <andrea.porta@suse.com>

description:
  The RaspberryPi RP1 is a PCI multi function device containing
  peripherals ranging from Ethernet to USB controller, I2C, SPI
  and others.
  The peripherals are accessed by addressing the PCI BAR1 region.

allOf:
  - $ref: /schemas/pci/pci-ep-bus.yaml

properties:
  compatible:
    additionalItems: true
    maxItems: 3
    items:
      - const: pci1de4,1

patternProperties:
  "^pci-ep-bus@[0-2]$":
    $ref: '#/$defs/bar-bus'
    description:
      The bus on which the peripherals are attached, which is addressable
      through the BAR.

unevaluatedProperties: false

$defs:
  bar-bus:
    $ref: /schemas/pci/pci-ep-bus.yaml#/$defs/pci-ep-bus
    unevaluatedProperties: false

    properties:
      "#interrupt-cells":
        const: 2
        description:
          Specifies respectively the interrupt number and flags as defined
          in include/dt-bindings/interrupt-controller/irq.h.

      interrupt-controller: true

      interrupt-parent:
        description:
          Must be the phandle of this 'pci-ep-bus' node. It will trigger
          PCI interrupts on behalf of peripheral generated interrupts.

    patternProperties:
      "^clocks(@[0-9a-f]+)?$":
        type: object
        $ref: /schemas/clock/raspberrypi,rp1-clocks.yaml

      "^ethernet(@[0-9a-f]+)?$":
        type: object
        $ref: /schemas/net/cdns,macb.yaml

      "^pinctrl(@[0-9a-f]+)?$":
        type: object
        $ref: /schemas/pinctrl/raspberrypi,rp1-gpio.yaml

    required:
      - interrupt-parent
      - interrupt-controller

examples:
  - |
    pci {
        #address-cells = <3>;
        #size-cells = <2>;

        rp1@0,0 {
            compatible = "pci1de4,1";
            ranges = <0x01 0x00 0x00000000
                      0x82010000 0x00 0x00
                      0x00 0x400000>;
            #address-cells = <3>;
            #size-cells = <2>;

            pci_ep_bus: pci-ep-bus@1 {
                compatible = "simple-bus";
                ranges = <0xc0 0x40000000
                          0x01 0x00 0x00000000
                          0x00 0x00400000>;
                dma-ranges = <0x10 0x00000000
                              0x43000000 0x10 0x00000000
                              0x10 0x00000000>;
                #address-cells = <2>;
                #size-cells = <2>;
                interrupt-controller;
                interrupt-parent = <&pci_ep_bus>;
                #interrupt-cells = <2>;

                rp1_clocks: clocks@c040018000 {
                    compatible = "raspberrypi,rp1-clocks";
                    reg = <0xc0 0x40018000 0x0 0x10038>;
                    #clock-cells = <1>;
                    clocks = <&clk_rp1_xosc>;
                    clock-names =  "rp1-xosc";
                };
            };
        };
    };
```
