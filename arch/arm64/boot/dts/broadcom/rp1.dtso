// SPDX-License-Identifier: (GPL-2.0 OR MIT)

#include <dt-bindings/gpio/gpio.h>
#include <dt-bindings/interrupt-controller/irq.h>
#include <dt-bindings/clock/raspberrypi,rp1-clocks.h>

/dts-v1/;
/plugin/;

/ {
	fragment@0 {
		target-path="";
		__overlay__ {
			compatible = "pci1de4,1";
			#address-cells = <3>;
			#size-cells = <2>;
			interrupt-controller;
			#interrupt-cells = <2>;

			pci_ep_bus: pci-ep-bus@1 {
				compatible = "simple-bus";
				ranges = <0x00 0x40000000  0x01 0x00 0x00000000  0x00 0x00400000>;
				dma-ranges = <0x10 0x00000000  0x43000000 0x10 0x00000000  0x10 0x00000000>;
				#address-cells = <2>;
				#size-cells = <2>;
			};
		};
	};
};
