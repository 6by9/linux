/*
 * Device Tree overlay for fbtft drivers
 */

/dts-v1/;
/plugin/;

#include <dt-bindings/gpio/gpio.h>

/ {
	compatible = "brcm,bcm2835";

	/* Adafruit 1.8" 120x160 ST7735 */
	fragment@0 {
		target = <&display>;
		__dormant__ {
			compatible = "jianda,jd-t18003-t01";
			spi-max-frequency = <32000000>;
		};
	};

	/* Adafruit / Waveshare ILI9341 2.4" */
	fragment@1 {
		target = <&display>;
		__dormant__ {
			compatible = "adafruit,yx240qv29";
			spi-max-frequency = <32000000>;
			//dc-gpios = <&gpio 24 GPIO_ACTIVE_HIGH>;
			//reset-gpios = <&gpio 25 GPIO_ACTIVE_HIGH>;
		};
	};

	spidev_fragment: fragment@100 {
		target-path = "spi0/spidev@0";
		__overlay__ {
			status = "disabled";
		};
	};

	fragment@101 {
		target = <&display>;
		__dormant__  {
			backlight = <&backlight>;
		};
	};

	display_fragment: fragment@102 {
		target = <&spi0>;
		__overlay__ {
			/* needed to avoid dtc warning */
			#address-cells = <1>;
			#size-cells = <0>;

			status = "okay";

			display: display@0{
				reg = <0>;
				spi-max-frequency = <32000000>;
			};
		};
	};

	fragment@103 {
		target-path = "/";
		__dormant__ {
			backlight: backlight@0 {
				reg = <0>;
				compatible = "gpio-backlight";
				status = "okay";
				//led-gpios = <&gpio 18 GPIO_ACTIVE_HIGH>;
			};
		};
	};

	__overrides__ {
		spi0-0        = <&display_fragment>, "target:0=",<&spi0>,
				<&spidev_fragment>, "target-path=spi0/spidev@0",
				<&display>, "reg:0=0";
		spi0-1        = <&display_fragment>, "target:0=",<&spi0>,
				<&spidev_fragment>, "target-path=spi0/spidev@1",
				<&display>, "reg:0=1";
		spi1-0        = <&display_fragment>, "target:0=",<&spi1>,
				<&spidev_fragment>, "target-path=spi1/spidev@0",
				<&display>, "reg:0=0";
		spi1-1        = <&display_fragment>, "target:0=",<&spi1>,
				<&spidev_fragment>, "target-path=spi1/spidev@1",
				<&display>, "reg:0=1";
		spi1-2        = <&display_fragment>, "target:0=",<&spi1>,
				<&spidev_fragment>, "target-path=spi1/spidev@2",
				<&display>, "reg:0=2";
		spi2-0        = <&display_fragment>, "target:0=",<&spi2>,
				<&spidev_fragment>, "target-path=spi2/spidev@0",
				<&display>, "reg:0=0";
		spi2-1        = <&display_fragment>, "target:0=",<&spi2>,
				<&spidev_fragment>, "target-path=spi2/spidev@1",
				<&display>, "reg:0=1";
		spi2-2        = <&display_fragment>, "target:0=",<&spi2>,
				<&spidev_fragment>, "target-path=spi2/spidev@2",
				<&display>, "reg:0=2";
		spi3-0        = <&display_fragment>, "target:0=",<&spi3>,
				<&spidev_fragment>, "target-path=spi3/spidev@0",
				<&display>, "reg:0=0";

		speed         = <&display>, "spi-max-frequency:0";

		/* Displays */
		adafruit18    = <0>, "+0";
		waveshare24   = <0>, "+1";
/*		adafruit22    = <0>, "+1";
		adafruit22a   = <0>, "+2";
		adafruit28    = <0>, "+3";
		adafruit13m   = <0>, "+4";
		admatec_c-berry28 = <0>, "+5";
		dogs102       = <0>, "+6";
		er_tftm050_2  = <0>, "+7";
		er_tftm070_5  = <0>, "+8";
		ew24ha0       = <0>, "+9";
		ew24ha0_9bit  = <0>, "+10";
		freetronicsoled128 = <0>, "+11";
		hy28a         = <0>, "+12";
		hy28b         = <0>, "+13";
		itdb28_spi    = <0>, "+14";
		mi0283qt-2    = <0>, "+15";
		mi0283qt-9a   = <0>, "+16";
		nokia3310     = <0>, "+17";
		nokia3310a    = <0>, "+18";
		nokia5110     = <0>, "+19";
		piscreen      = <0>, "+20";
		pitft         = <0>, "+21";
		pioled        = <0>, "+22";
		rpi-display   = <0>, "+23";
		sainsmart18   = <0>, "+24";
		sainsmart32_spi = <0>, "+25";
		tinylcd35     = <0>, "+26";
		tm022hdh26    = <0>, "+27";
		tontec35_9481 = <0>, "+28";
		tontec35_9486 = <0>, "+29";
		waveshare32b  = <0>, "+30";
		waveshare22   = <0>, "+31";
*/
		/* Controllers */
/*		bd663474      = <&display>, "compatible=hitachi,bd663474";
		hx8340bn      = <&display>, "compatible=himax,hx8340bn";
		hx8347d       = <&display>, "compatible=himax,hx8347d";
		hx8353d       = <&display>, "compatible=himax,hx8353d";
		hx8357d       = <&display>, "compatible=himax,hx8357d";
		ili9163       = <&display>, "compatible=ilitek,ili9163";
		ili9320       = <&display>, "compatible=ilitek,ili9320";
		ili9325       = <&display>, "compatible=ilitek,ili9325";
		ili9340       = <&display>, "compatible=ilitek,ili9340";
		ili9341       = <&display>, "compatible=ilitek,ili9341";
		ili9481       = <&display>, "compatible=ilitek,ili9481";
		ili9486       = <&display>, "compatible=ilitek,ili9486";
		pcd8544       = <&display>, "compatible=philips,pcd8544";
		ra8875        = <&display>, "compatible=raio,ra8875";
		s6d02a1       = <&display>, "compatible=samsung,s6d02a1";
		s6d1121       = <&display>, "compatible=samsung,s6d1121";
		seps525       = <&display>, "compatible=syncoam,seps525";
		sh1106        = <&display>, "compatible=sinowealth,sh1106";
		ssd1289       = <&display>, "compatible=solomon,ssd1289";
		ssd1305       = <&display>, "compatible=solomon,ssd1305";
		ssd1306       = <&display>, "compatible=solomon,ssd1306";
		ssd1325       = <&display>, "compatible=solomon,ssd1325";
		ssd1331       = <&display>, "compatible=solomon,ssd1331";
		ssd1351       = <&display>, "compatible=solomon,ssd1351";
		st7735r       = <&display>, "compatible=sitronix,st7735r";
		st7789v       = <&display>, "compatible=sitronix,st7789v";
		tls8204       = <&display>, "compatible=teralane,tls8204";
		uc1611        = <&display>, "compatible=ultrachip,uc1611";
		uc1701        = <&display>, "compatible=UltraChip,uc1701";
		upd161704     = <&display>, "compatible=nec,upd161704";
*/
		rotate        = <&display>, "rotation:0";
		reset_pin     = <&display>, "reset-gpios:0=", <&gpio>,
				<&display>, "reset-gpios:4",
				<&display>, "reset-gpios:8=0"; /* GPIO_ACTIVE_HIGH */
		dc_pin        = <&display>, "dc-gpios:0=", <&gpio>,
				<&display>, "dc-gpios:4",
				<&display>, "dc-gpios:8=0"; /* GPIO_ACTIVE_HIGH */
		led_pin       = <0>, "+101+103",
				<&backlight>, "gpios:0=", <&gpio>,
				<&backlight>, "gpios:4",
				<&backlight>, "gpios:8=0"; /* GPIO_ACTIVE_HIGH */
		display_num   = <&backlight>, "reg:0";
	};
};
